## CMakeLists.txt
```
cmake_minimum_required(VERSION 3.20.0)

find_package(Zephyr REQUIRED HINTS $ENV{ZEPHYR_BASE})
project(bms)

target_sources(app PRIVATE src/main.c)
```

## prj.conf
```kconfig
# BMS — the device under test.
#
# Console over UART. Zephyr's nucleo_h743zi board definition selects usart3 as
# the console, which is the instance wired to the ST-Link virtual COM port on
# real hardware and the instance the harness taps in the emulator
# (harness/boards.yml: uart_peripheral: sysbus.usart3).
CONFIG_PRINTK=y
CONFIG_CONSOLE=y
CONFIG_SERIAL=y
CONFIG_UART_CONSOLE=y

# CAN. The controller comes from the devicetree `zephyr,canbus` chosen node,
# which this board points at fdcan1; no peripheral name appears in the C.
CONFIG_CAN=y

# Driver errors on the console rather than in silence. A CAN controller that
# fails to configure its bit timing still boots and still prints the banner --
# it just never speaks, which is indistinguishable from broken application
# logic unless the driver is allowed to say so. That failure mode cost a whole
# board bring-up on S32K (docs/STATUS.md §1.1), so it is diagnosable here by
# default. Immediate mode logs from the calling context, so nothing is
# buffered past the moment it mattered and nothing is deferred to a thread
# whose scheduling could vary.
CONFIG_LOG=y
CONFIG_LOG_MODE_IMMEDIATE=y
CONFIG_CAN_LOG_LEVEL_ERR=y

# No stack canaries or asserts stripped: this is the same binary shape we want
# to run under test, not a special emulator build. Bench's whole claim is that
# the binary under test is the binary that ships.
CONFIG_ASSERT=y
```

## boards/nucleo_h743zi.overlay
```dts
/*
 * CAN configuration for the powertrain bus.
 *
 * ---------------------------------------------------------------------------
 * BITRATE
 * ---------------------------------------------------------------------------
 * Zephyr's nucleo_h743zi devicetree ships fdcan1 with bus-speed = <125000> and
 * status = "disabled". network.yml says the powertrain bus runs at 500 kbit/s,
 * and scripts/build-firmware.sh reads the bitrate back out of the GENERATED
 * devicetree and fails the build if it does not equal network.yml's -- what
 * matters is what the compiler concluded, not what we believe we asked for.
 *
 * A silent mismatch is why that gate exists: nodes configured for different
 * bitrates produce a bus that carries no traffic at all, and neither the
 * firmware nor the emulator reports an error. It looks exactly like broken
 * application logic.
 *
 * ---------------------------------------------------------------------------
 * MESSAGE RAM: TRANSMIT BUFFERS 3 -> 6
 * ---------------------------------------------------------------------------
 * A node here can have five frames due in the same tick when its 100 / 250 /
 * 500 ms cadences coincide, and six when the independent fault rebroadcast
 * lands on the same tick as a fault being entered. The stock layout gives
 * three transmit buffers, so the later can_send() calls returned -EAGAIN after
 * their short timeout and the frame was DROPPED: the firmware decided to
 * transmit and nothing reached the wire.
 *
 * Measured on a real two-node run, before and after:
 *
 *   refused transmissions, first second     14  ->  0
 *   frames observed on the hub over 2 s     72  ->  108
 *
 * 108 is essentially the full expected load (52 from the BMS, 60 from the VCU,
 * less boot latency), so the third of the bus that was being dropped is back.
 * A scenario asserting on a dropped frame fails for a reason that has nothing
 * to do with the logic under test, which is the definition of a flaky
 * verification tool.
 *
 * Fields: <offset std-filters ext-filters rx-fifo0 rx-fifo1 rx-buffers
 *          tx-event-fifo tx-buffers>
 *
 * The budget is fixed and tight. fdcan1's message_ram region is 0x350 = 848
 * bytes, and the STOCK layout uses exactly 848 -- there is no spare byte to
 * take. Element sizes are 4 bytes per standard filter, 8 per extended filter,
 * 8 per tx-event entry, and 72 for every rx/tx element (an 8-byte header plus
 * a 64-byte data area, sized for CAN FD even though FD mode is off here).
 *
 *   stock  28  8  3 3 0  3 3  ->  112 + 64 + 216 + 216 + 0 + 24 + 216 = 848
 *   here    8  0  3 1 0  5 6  ->   32 +  0 + 216 +  72 + 0 + 40 + 432 = 792
 *
 * The space comes from filters and the second rx FIFO, both of which were
 * oversized for this project: the contract uses standard 11-bit identifiers
 * only, so the eight extended-filter slots were dead weight, and no node
 * installs more than a handful of filters. 56 bytes remain spare.
 */

&fdcan1 {
	bus-speed = <500000>;
	bosch,mram-cfg = <0x0 8 0 3 1 0 5 6>;
	status = "okay";
};
```

## src/main.c
```c
/*
 * BMS — battery management system. The device under test.
 *
 * Owns the high-voltage pack: decides whether the main contactor may close,
 * enforces five safety rules, and publishes the pack's state on CAN.
 *
 * ---------------------------------------------------------------------------
 * DETERMINISM (R1)
 * ---------------------------------------------------------------------------
 * Two runs must produce identical results to the microsecond, so this
 * firmware contains:
 *
 *   no rand(), no PRNG, no hash of an address, nothing seeded by anything;
 *   no wall-clock read anywhere in the decision path — every timeout is
 *     expressed against now_ms, which is a count of executed loop iterations
 *     times BMS_TICK_MS and nothing else;
 *   no uninitialised reads — bms_t is zeroed and then explicitly seeded
 *     before the first tick;
 *   no floating point, so no rounding-mode or FPU-state dependence;
 *   no unbounded blocking — the transmit path never waits on the wire, so
 *     bus conditions cannot change how many ticks elapse.
 *
 * The one thing that touches a clock is the pacing timer, and it is a
 * periodic k_timer re-armed by the kernel from the previous expiry, so it
 * cannot accumulate drift. Under Renode that clock is virtual time.
 *
 * ---------------------------------------------------------------------------
 * THE TICK
 * ---------------------------------------------------------------------------
 * One 10 ms loop, in a fixed order, every time:
 *
 *   1  advance time and the three age counters
 *   2  sample the four injectable sensor inputs, once, into this tick's
 *      snapshot, so every rule and every frame sees the same reading
 *   3  drain received frames                      (can_io.c)
 *   4  run the five safety rules                  (safety.c)
 *   5  run the state machine
 *   6  derive the published outputs
 *   7  transmit whatever this tick's cadence timers make due  (can_io.c)
 */

#include <string.h>

#include <zephyr/kernel.h>
#include <zephyr/sys/printk.h>

#include "bms.h"

/* ===========================================================================
 * The injectable sensor inputs
 * ===========================================================================
 * The harness writes these through the ELF symbol table, into the running
 * machine's memory, exactly as a sensor driver ISR would — so the firmware
 * cannot distinguish "the temperature sensor reported this" from "the test
 * wrote this". That is the whole injection mechanism: no sensor peripheral
 * models are needed, and in exchange the sensor driver and its I2C/ADC
 * transaction are not exercised.
 *
 * volatile stops the compiler folding away a global this translation unit
 * only reads. It does NOT stop the linker collecting it: Zephyr compiles with
 * -fdata-sections and links with --gc-sections, so each of these lands in its
 * own .data/.bss section and any section nothing references is discarded.
 * That is why injectables.txt exists — CMakeLists.txt turns each name into
 * -Wl,--undefined=<sym>, and scripts/build-firmware.sh then asserts each one
 * really survived into the ELF. A collected symbol would give write_symbol no
 * address to write, and the injected fault would silently never happen while
 * the scenario still reported PASS.
 *
 * They are also genuinely read, every single tick, and every one of them
 * drives real logic:
 *
 *   g_cell_temp_dC  rule 1, the discharge derate, the charge inhibit, and the
 *                   session temperature extremes in 0x601
 *   g_pack_mv       rules 2 and 3, the SOC line, the per-cell estimates in
 *                   0x603, the full-pack charge inhibit
 *   g_pack_ma       the IR compensation that corrects terminal voltage to
 *                   open-circuit voltage before the SOC lookup, and
 *                   pack_current_ma in 0x600
 *   g_tx_enable     gates every transmission, checked on every cycle
 */
volatile int32_t g_cell_temp_dC = 250;   /* deci-degrees C — 25.0 C          */
volatile int32_t g_pack_mv      = 72000; /* millivolts     — 72.000 V        */
volatile int32_t g_pack_ma      = 0;     /* milliamps: + discharge, - charge */
volatile uint8_t g_tx_enable    = 1;     /* 0 stops all CAN transmission     */

/* The pacing timer. Periodic k_timers are re-armed by the kernel from the
 * previous expiry, so the loop cannot drift even if a tick's work varies. */
K_TIMER_DEFINE(bms_tick_timer, NULL, NULL);

static bms_t bms;

/* ===========================================================================
 * Names, for the console only
 * ===========================================================================
 */

const char *bms_state_name(bms_state_t s)
{
	switch (s) {
	case BMS_STATE_INIT:      return "INIT";
	case BMS_STATE_STANDBY:   return "STANDBY";
	case BMS_STATE_PRECHARGE: return "PRECHARGE";
	case BMS_STATE_RUNNING:   return "RUNNING";
	case BMS_STATE_CHARGING:  return "CHARGING";
	case BMS_STATE_FAULT:     return "FAULT";
	default:                  return "?";
	}
}

const char *bms_fault_name(uint8_t code)
{
	switch (code) {
	case BMS_FAULT_NONE:           return "NONE";
	case BMS_FAULT_OVERTEMP:       return "OVERTEMP";
	case BMS_FAULT_OVERVOLT:       return "OVERVOLT";
	case BMS_FAULT_UNDERVOLT:      return "UNDERVOLT";
	case BMS_FAULT_HEARTBEAT_LOST: return "HEARTBEAT_LOST";
	case BMS_FAULT_CHARGE_LOST:    return "CHARGE_LOST";
	default:                       return "?";
	}
}

static const char *contactor_name(uint8_t s)
{
	switch (s) {
	case BMS_CONTACTOR_OPEN:      return "OPEN";
	case BMS_CONTACTOR_PRECHARGE: return "PRECHARGE";
	case BMS_CONTACTOR_CLOSED:    return "CLOSED";
	default:                      return "?";
	}
}

/* ===========================================================================
 * State machine
 * ===========================================================================
 *   INIT -> STANDBY -> PRECHARGE -> RUNNING
 *                          |            |
 *                          +-> CHARGING |
 *                                       v
 *                                    FAULT   (contactor opens)
 */

void bms_set_state(bms_t *c, bms_state_t next)
{
	if (c->state == next) {
		return;
	}
	printk("bms state %s -> %s @%u ms\n",
	       bms_state_name(c->state), bms_state_name(next), c->now_ms);
	c->state    = next;
	c->state_ms = 0U;
}

static void state_machine_run(bms_t *c)
{
	switch (c->state) {
	case BMS_STATE_INIT:
		/* CAN is already up by the time the loop runs. INIT is one tick
		 * wide, so the transition is visible on the console and the
		 * startup order is observable. */
		bms_set_state(c, BMS_STATE_STANDBY);
		break;

	case BMS_STATE_STANDBY:
		/* Contactor open, pack idle. A low pack here is a flat battery,
		 * not a fault — see rule 3. */
		if (c->drive_request || c->charge_request) {
			bms_set_state(c, BMS_STATE_PRECHARGE);
		}
		break;

	case BMS_STATE_PRECHARGE:
		if (!c->drive_request && !c->charge_request) {
			/* Request withdrawn mid-precharge: fall back rather than
			 * closing the main contactor onto nothing. */
			bms_set_state(c, BMS_STATE_STANDBY);
		} else if (c->state_ms >= BMS_PRECHARGE_DWELL_MS) {
			/* Drive wins when both are asserted: rider intent
			 * outranks a charge session. */
			bms_set_state(c, c->drive_request ? BMS_STATE_RUNNING
							  : BMS_STATE_CHARGING);
		}
		break;

	case BMS_STATE_RUNNING:
		if (!c->drive_request) {
			bms_set_state(c, BMS_STATE_STANDBY);
		}
		break;

	case BMS_STATE_CHARGING:
		/*
		 * Note what does NOT appear here: charge loss. A charger that
		 * has gone quiet leaves charge_request set — silence withdraws
		 * nothing — so the node stays in CHARGING with the contactor
		 * opened by rule 5, which is precisely what lets that rule be
		 * non-latching. Only a charger that explicitly reports IDLE,
		 * COMPLETE, SUSPENDED or FAULT ends the session.
		 */
		if (!c->charge_request) {
			c->charge_lost = false;
			c->fault_code  = BMS_FAULT_NONE;
			bms_set_state(c, BMS_STATE_STANDBY);
		}
		break;

	case BMS_STATE_FAULT:
		/* Terminal. Nothing leaves this state — that is what LATCHED
		 * means at the state-machine level. Only a reset clears it. */
		break;

	default:
		bms_set_state(c, BMS_STATE_FAULT);
		break;
	}
}

/* ===========================================================================
 * Derived outputs
 * ===========================================================================
 */

static uint16_t clamp_u16(int32_t v)
{
	if (v < 0) {
		return 0U;
	}
	if (v > 65535) {
		return 65535U;
	}
	return (uint16_t)v;
}

/* The contactor is a pure function of the state plus the one non-latching
 * condition that can open it without changing state. */
static uint8_t contactor_for(const bms_t *c)
{
	switch (c->state) {
	case BMS_STATE_PRECHARGE:
		return BMS_CONTACTOR_PRECHARGE;
	case BMS_STATE_RUNNING:
		return BMS_CONTACTOR_CLOSED;
	case BMS_STATE_CHARGING:
		/* Rule 5: charging power lost opens the contactor and closes it
		 * again on re-handshake, without leaving CHARGING. */
		return c->charge_lost ? BMS_CONTACTOR_OPEN : BMS_CONTACTOR_CLOSED;
	case BMS_STATE_FAULT:
	case BMS_STATE_INIT:
	case BMS_STATE_STANDBY:
	default:
		return BMS_CONTACTOR_OPEN;
	}
}

static void derive_outputs(bms_t *c)
{
	int32_t mv, ma, ocv_mv, soc, mean_cell_mv;

	/* Session temperature extremes. These two are genuinely measured: they
	 * are the running max and min of everything that has been injected. */
	if (c->temp_dC > c->temp_max_dC) {
		c->temp_max_dC = c->temp_dC;
	}
	if (c->temp_dC < c->temp_min_dC) {
		c->temp_min_dC = c->temp_dC;
	}

	c->contactor = contactor_for(c);

	/*
	 * Local copies clamped to their declared wire widths BEFORE any
	 * arithmetic, so an out-of-range injection cannot overflow the sums
	 * below. The safety rules deliberately do not do this: they compare
	 * the raw values, so a boundary sweep gets exact arithmetic.
	 */
	mv = c->pack_mv;
	if (mv < 0) {
		mv = 0;
	} else if (mv > 0xFFFFFF) {
		mv = 0xFFFFFF;
	}
	ma = c->pack_ma;
	if (ma > 8388607) {
		ma = 8388607;
	} else if (ma < -8388608) {
		ma = -8388608;
	}

	/*
	 * SOC — DEMO CALIBRATION, NOT AN ALGORITHM.
	 *
	 * One IR compensation and one straight line. Terminal voltage sags
	 * under discharge and rises under charge, so the measured voltage is
	 * corrected by I*R with a single fixed internal resistance to get an
	 * open-circuit estimate, and that is mapped linearly between the empty
	 * and full pack voltages.
	 *
	 * A shipping BMS coulomb-counts, carries an OCV/SOC curve per cell
	 * chemistry, and re-fits it against temperature and age. This does none
	 * of that and is not dressed up to look as though it does. It exists so
	 * the bus carries a plausible, deterministic number that moves when the
	 * injected pack voltage and current move.
	 */
	ocv_mv = mv + (ma * BMS_PACK_R_INT_mOHM) / 1000;
	if (ocv_mv < BMS_PACK_EMPTY_mV) {
		ocv_mv = BMS_PACK_EMPTY_mV;
	} else if (ocv_mv > BMS_PACK_FULL_mV) {
		ocv_mv = BMS_PACK_FULL_mV;
	}
	soc = ((ocv_mv - BMS_PACK_EMPTY_mV) * 100) /
	      (BMS_PACK_FULL_mV - BMS_PACK_EMPTY_mV);
	c->soc_pct = (uint8_t)soc;   /* 0..100 by construction of the clamp above */

	/*
	 * Per-cell voltages — DEMO CALIBRATION. There is no per-cell sensor to
	 * inject, so the pack average is divided by the series count and a
	 * fixed spread applied. Real cell-level health needs real cell taps.
	 */
	mean_cell_mv   = mv / BMS_PACK_CELLS;
	c->cell_max_mv = clamp_u16(mean_cell_mv + BMS_CELL_SPREAD_mV);
	c->cell_min_mv = clamp_u16(mean_cell_mv - BMS_CELL_SPREAD_mV);

	/* soh_pct is a constant (BMS_SOH_PCT). Stating that plainly rather than
	 * computing a number that would only look like an estimate. */

	/*
	 * Current limits — DEMO CALIBRATION. A real limit table is
	 * two-dimensional in temperature and SOC; this is two derate steps and
	 * a couple of inhibits, all driven by the injected values.
	 */
	if (c->contactor != BMS_CONTACTOR_CLOSED) {
		/* Nothing may flow through an open or precharging contactor. */
		c->discharge_limit_da = 0U;
		c->charge_limit_da    = 0U;
	} else {
		c->discharge_limit_da = (c->temp_dC > BMS_DERATE_TEMP_dC)
					? BMS_DISCHARGE_LIMIT_HOT_da
					: BMS_DISCHARGE_LIMIT_da;
		if (c->soc_pct == 0U) {
			c->discharge_limit_da = 0U;   /* empty pack */
		}

		c->charge_limit_da = ((c->temp_dC > BMS_CHARGE_INHIBIT_TEMP_dC) ||
				      (c->pack_mv >= BMS_PACK_FULL_mV))
				     ? 0U
				     : BMS_CHARGE_LIMIT_da;
	}
}

/* ===========================================================================
 * Console
 * ===========================================================================
 * One line per second, driven by the tick counter rather than by a clock, so
 * the console transcript is itself deterministic and can be diffed between
 * runs. Transitions and faults print as they happen, from the functions that
 * cause them.
 */
static void console_status(const bms_t *c)
{
	int32_t t   = c->temp_dC;
	int32_t whole = t / 10;
	int32_t frac  = (t < 0 ? -t : t) % 10;

	printk("bms t=%u ms state=%s contactor=%s fault=%s temp=%d.%d C "
	       "pack=%d mV cur=%d mA soc=%u%% rx=%u/%u txerr=%u\n",
	       c->now_ms, bms_state_name(c->state), contactor_name(c->contactor),
	       bms_fault_name(c->fault_code), whole, frac,
	       c->pack_mv, c->pack_ma, c->soc_pct,
	       c->rx_vcu_count, c->rx_chg_count, bms_can_tx_errors());
}

/* ===========================================================================
 * main
 * ===========================================================================
 */

int main(void)
{
	/* R5: network.yml's boot_text for this node, verbatim, on its own line,
	 * as the first thing main() prints. Every scenario waits for it. */
	printk("BMS ready\n");

	/* No uninitialised reads anywhere in the decision path (R1). */
	memset(&bms, 0, sizeof(bms));
	bms.state       = BMS_STATE_INIT;
	bms.fault_code  = BMS_FAULT_NONE;
	bms.contactor   = BMS_CONTACTOR_OPEN;
	bms.temp_max_dC = g_cell_temp_dC;
	bms.temp_min_dC = g_cell_temp_dC;

	if (bms_can_init() != 0) {
		/* Say so and keep running the safety logic. A BMS that cannot
		 * talk still must not close a contactor it should not, and a
		 * silent exit here would look identical on the UART to a
		 * firmware that hung. */
		printk("bms CAN unavailable, continuing without the bus\n");
	}

	k_timer_start(&bms_tick_timer, K_MSEC(BMS_TICK_MS), K_MSEC(BMS_TICK_MS));

	for (;;) {
		/* Blocks until the next period. The kernel re-arms from the
		 * previous expiry, so this loop runs on an exact 10 ms grid. */
		(void)k_timer_status_sync(&bms_tick_timer);

		/* 1 — time. now_ms is a count of ticks, not a clock reading. */
		bms.now_ms        += BMS_TICK_MS;
		bms.state_ms      += BMS_TICK_MS;
		bms.vcu_age_ms    += BMS_TICK_MS;
		bms.charge_age_ms += BMS_TICK_MS;

		/* 2 — one coherent snapshot of the sensor inputs for this tick.
		 * Sampling once means a rule cannot fire on a value that the
		 * frame it triggered does not report. */
		bms.temp_dC = g_cell_temp_dC;
		bms.pack_mv = g_pack_mv;
		bms.pack_ma = g_pack_ma;
		bms.tx_on   = g_tx_enable;

		/* 3 — what the bus said. */
		bms_can_service_rx(&bms);

		/* 4 — the five safety rules, before anything else can act on
		 * stale permission. */
		bms_safety_run(&bms);

		/* 5, 6 — where we are, and what that means for the outputs. */
		state_machine_run(&bms);
		derive_outputs(&bms);

		/* 7 — the wire. */
		bms_can_service_tx(&bms);

		if ((bms.now_ms % 1000U) == 0U) {
			console_status(&bms);
		}
	}

	return 0;
}
```

## src/bms.h
```c
/*
 * bms.h — the BMS's whole vocabulary in one place.
 *
 * Everything here that is a number on the wire (message id, dlc, start_bit,
 * signal width, enum value) is copied from catalog.yml and carries the
 * catalog line it came from in its comment. If catalog.yml changes, this file
 * changes with it; nothing else in the firmware carries a bus constant.
 *
 * Everything here that is a threshold is a SAFETY constant, and the qualifier
 * (strictly-greater vs inclusive, latched vs not, which state it applies in)
 * lives with the constant, because the qualifier is the part that gets a real
 * firmware wrong.
 */

#ifndef BMS_H_
#define BMS_H_

#include <stdbool.h>
#include <stdint.h>

/* ===========================================================================
 * Control loop
 * ===========================================================================
 * One 10 ms tick. Every period in this firmware is an exact multiple of it,
 * so no timer ever needs to round, and firmware time is a plain count of
 * ticks rather than a clock reading. See main.c for why that matters (R1).
 */
#define BMS_TICK_MS                 10U

/* ===========================================================================
 * Safety thresholds — the qualifier is the specification, not the number
 * ===========================================================================
 */

/* Rule 1 — over-temperature. STRICTLY greater: exactly 55.0 C is legal.
 * Applies in ANY state, and the resulting fault is LATCHED: once set it
 * survives the temperature coming back down. Only a reset clears it. */
#define BMS_OVERTEMP_LIMIT_dC       550

/* Rule 2 — pack over-voltage. BOUNDARY INCLUSIVE: 84000 mV is legal,
 * 84001 mV faults. Applies in any state. Latched. */
#define BMS_OVERVOLT_LIMIT_mV       84000

/* Rule 3 — pack under-voltage. STRICTLY less: exactly 60000 mV is legal.
 * Applies ONLY WHILE RUNNING — a low pack sitting in STANDBY is a flat
 * battery, not a safety event. Latched once it does fire. */
#define BMS_UNDERVOLT_LIMIT_mV      60000

/* Rule 4 — VCU heartbeat loss. The VCU beats every 100 ms, so 300 ms is
 * three missed beats. DRIVING ONLY (state RUNNING), and only once a first
 * heartbeat has been seen — an ECU that has never spoken has not gone quiet.
 * Latched. */
#define BMS_VCU_TIMEOUT_MS          300U

/* Rule 5 — charging power loss. Same 300 ms window, measured on charger
 * frames that report an active session. NON-LATCHING: the contactor opens,
 * and it closes again by itself when the charger re-handshakes. */
#define BMS_CHARGE_TIMEOUT_MS       300U

/* How long the precharge resistor stays in circuit before the main contactor
 * closes. Not a safety threshold — an inrush-limiting dwell. */
#define BMS_PRECHARGE_DWELL_MS      200U

/* ===========================================================================
 * Transmit cadence (catalog.yml senders + the task's cadence table)
 * ===========================================================================
 * Five independent timers. The fault rebroadcast is deliberately NOT derived
 * from the cells timer even though both are 500 ms, and deliberately NOT tied
 * to the code path that enters a fault: entering a fault and periodically
 * restating one are different events, and both legitimately land in the same
 * tick. See can_io.c.
 */
#define BMS_TX_PERIOD_STATUS_MS     100U   /* 0x600 */
#define BMS_TX_PERIOD_LIMITS_MS     100U   /* 0x602 */
#define BMS_TX_PERIOD_TEMPS_MS      250U   /* 0x601 */
#define BMS_TX_PERIOD_CELLS_MS      500U   /* 0x603 */
#define BMS_TX_PERIOD_FAULT_MS      500U   /* 0x604 rebroadcast, independent  */

/* ===========================================================================
 * Message identities — catalog.yml `messages:`
 * ===========================================================================
 */
#define BMS_MSG_STATUS_ID           0x600U   /* bms_status,     dlc 8 */
#define BMS_MSG_STATUS_DLC          8U
#define BMS_MSG_TEMPS_ID            0x601U   /* bms_temps,      dlc 6 */
#define BMS_MSG_TEMPS_DLC           6U
#define BMS_MSG_LIMITS_ID           0x602U   /* bms_limits,     dlc 6 */
#define BMS_MSG_LIMITS_DLC          6U
#define BMS_MSG_CELLS_ID            0x603U   /* bms_cells,      dlc 6 */
#define BMS_MSG_CELLS_DLC           6U
#define BMS_MSG_FAULT_ID            0x604U   /* bms_fault,      dlc 8 */
#define BMS_MSG_FAULT_DLC           8U

/* Received. These are the only two ids the BMS subscribes to; every other id
 * on the bus is filtered out in the controller and never reaches the CPU,
 * which is why an unexpected frame cannot raise a fault here. */
#define BMS_MSG_VCU_COMMAND_ID      0x200U   /* vcu_command,    dlc 8 */
#define BMS_MSG_CHARGER_STATUS_ID   0x300U   /* charger_status, dlc 8 */

/* ===========================================================================
 * Enum values — catalog.yml `enums:`
 * ===========================================================================
 */

/* enum fault_code (bms_fault.fault_code) */
#define BMS_FAULT_NONE              0U
#define BMS_FAULT_OVERTEMP          1U
#define BMS_FAULT_OVERVOLT          2U
#define BMS_FAULT_UNDERVOLT         3U
#define BMS_FAULT_HEARTBEAT_LOST    4U
#define BMS_FAULT_CHARGE_LOST       5U
/* 6 OVERCURRENT and 7 ISOLATION_FAULT exist in the catalog for other
 * hardware; this node has no shunt-trip or isolation monitor to raise them,
 * so it never publishes them. */

/* enum contactor_state (bms_limits.contactor_state) */
#define BMS_CONTACTOR_OPEN          0U
#define BMS_CONTACTOR_PRECHARGE     1U
#define BMS_CONTACTOR_CLOSED        2U
/* 3 WELDED and 4 FAULT need a contactor feedback contact, which this node
 * does not have. Never published. */

/* enum drive_state (vcu_command.drive_state) */
#define BMS_DRIVE_PARKED            0U
#define BMS_DRIVE_READY             1U
#define BMS_DRIVE_DRIVE             2U
#define BMS_DRIVE_REVERSE           3U
#define BMS_DRIVE_LIMP              4U
#define BMS_DRIVE_SHUTDOWN          5U

/* enum charge_state (charger_status.charge_state) */
#define BMS_CHARGE_IDLE             0U
#define BMS_CHARGE_CONNECTED        1U
#define BMS_CHARGE_HANDSHAKE        2U
#define BMS_CHARGE_CONSTANT_CURRENT 3U
#define BMS_CHARGE_CONSTANT_VOLTAGE 4U
#define BMS_CHARGE_COMPLETE         5U
#define BMS_CHARGE_SUSPENDED        6U
#define BMS_CHARGE_FAULT            7U

/* ===========================================================================
 * Pack model — DEMO CALIBRATION, NOT ALGORITHMS
 * ===========================================================================
 * A shipping BMS derives these from per-cell measurement, coulomb counting
 * and an ageing model. This node has three injected sensor values and no
 * per-cell hardware, so the numbers below are a deliberately simple
 * calibration whose only job is to put plausible, deterministic values on
 * the bus. They are not estimators and are not presented as such.
 */
#define BMS_PACK_CELLS              20      /* 20 series cells ~= 72 V nominal */
#define BMS_PACK_EMPTY_mV           60000   /* 0 % point of the SOC line       */
#define BMS_PACK_FULL_mV            84000   /* 100 % point of the SOC line     */
#define BMS_PACK_R_INT_mOHM         50      /* fixed internal resistance       */
#define BMS_CELL_SPREAD_mV          15      /* fixed max/min spread about mean */
#define BMS_SOH_PCT                 98U     /* a constant, honestly            */

/* Current limits — also calibration. A real limit table is two-dimensional in
 * temperature and SOC; this is a two-step derate. */
#define BMS_DISCHARGE_LIMIT_da      1500U   /* 150.0 A nominal                 */
#define BMS_DISCHARGE_LIMIT_HOT_da  500U    /* 50.0 A above the derate temp    */
#define BMS_CHARGE_LIMIT_da         300U    /* 30.0 A nominal                  */
#define BMS_DERATE_TEMP_dC          450     /* 45.0 C — warning, not a fault   */
#define BMS_CHARGE_INHIBIT_TEMP_dC  500     /* 50.0 C — stop accepting charge  */

/* ===========================================================================
 * State machine
 * ===========================================================================
 *   INIT -> STANDBY -> PRECHARGE -> RUNNING
 *                          |            |
 *                          +-> CHARGING |
 *                                       v
 *                                    FAULT   (contactor opens)
 */
typedef enum {
	BMS_STATE_INIT = 0,
	BMS_STATE_STANDBY,
	BMS_STATE_PRECHARGE,
	BMS_STATE_RUNNING,
	BMS_STATE_CHARGING,
	BMS_STATE_FAULT,
} bms_state_t;

/* ===========================================================================
 * The whole of the BMS's mutable state
 * ===========================================================================
 * One struct, one owner (the control loop), passed by pointer to the safety
 * rules and by const pointer to the transmit path. No hidden globals besides
 * the four injectables, which are sensor inputs rather than state.
 */
typedef struct {
	/* Time, in milliseconds since the loop started. This is a count of
	 * ticks, not a clock reading: every timeout in this firmware is
	 * expressed against it, so behaviour depends on nothing but the number
	 * of loop iterations executed. */
	uint32_t now_ms;

	/* This tick's snapshot of the four injectable sensor inputs. Sampled
	 * once, at the top of the tick, so that every rule and every frame in
	 * this tick sees exactly the same reading — a rule cannot see a value
	 * the frame it triggered does not report. */
	int32_t  temp_dC;
	int32_t  pack_mv;
	int32_t  pack_ma;
	uint8_t  tx_on;

	/* State machine */
	bms_state_t state;
	uint32_t    state_ms;        /* time spent in the current state */

	/* What the bus has told us. Requests persist between receptions: a
	 * request is withdrawn by a frame that says so, not by silence.
	 * Silence is what the two timeout rules are for. */
	bool     drive_request;      /* VCU wants HV up   */
	bool     charge_request;     /* charger is active */
	bool     vcu_seen;           /* at least one vcu_command has arrived */
	uint32_t vcu_age_ms;         /* since the last vcu_command           */
	uint32_t charge_age_ms;      /* since the last ACTIVE charger_status */
	uint8_t  vcu_heartbeat;      /* last received vcu_heartbeat value    */
	uint8_t  charge_state;       /* last received charge_state value     */
	uint32_t rx_vcu_count;       /* frames received, for the console     */
	uint32_t rx_chg_count;

	/* Safety verdict */
	uint8_t  fault_code;         /* enum fault_code, published in 0x604 */
	bool     fault_latched;      /* true once a latching rule has fired */
	bool     charge_lost;        /* rule 5, non-latching                */

	/* Raised by handle_*() at the instant a fault is entered, consumed by
	 * the transmit stage. Kept strictly separate from the 500 ms fault
	 * rebroadcast timer: they are different events and may coincide. */
	bool     fault_event_pending;

	/* Outputs */
	uint8_t  contactor;          /* enum contactor_state */
	uint8_t  soc_pct;
	uint16_t discharge_limit_da;
	uint16_t charge_limit_da;
	int32_t  temp_max_dC;        /* session maximum of the injected temp */
	int32_t  temp_min_dC;        /* session minimum of the injected temp */
	uint16_t cell_max_mv;        /* demo calibration, see derive_outputs */
	uint16_t cell_min_mv;

	/* Rolling counters. Both wrap at 256 by declared width. */
	uint8_t  heartbeat;          /* bms_status.bms_heartbeat  */
	uint8_t  fault_counter;      /* bms_fault.fault_counter   */
} bms_t;

/* ---------------------------------------------------------------------------
 * main.c
 * ------------------------------------------------------------------------ */

/* The four injectable sensor inputs. The harness writes these through the ELF
 * symbol table exactly as a sensor driver ISR would, so the firmware cannot
 * tell the two apart. Declared in injectables.txt, which CMakeLists.txt turns
 * into -Wl,--undefined=<sym> and the build script asserts against the ELF. */
extern volatile int32_t g_cell_temp_dC;   /* deci-degrees C                     */
extern volatile int32_t g_pack_mv;        /* millivolts                         */
extern volatile int32_t g_pack_ma;        /* milliamps: + discharge, - charge   */
extern volatile uint8_t g_tx_enable;      /* 0 stops all CAN transmission       */

const char *bms_state_name(bms_state_t s);
const char *bms_fault_name(uint8_t code);

/* The only way the state changes. Logs the transition, resets state_ms. */
void bms_set_state(bms_t *c, bms_state_t next);

/* ---------------------------------------------------------------------------
 * safety.c — one check_/handle_ pair per rule, so that a changed rule maps to
 * exactly one function and therefore to a known set of affected signals.
 * ------------------------------------------------------------------------ */
bool bms_check_overtemp(const bms_t *c);
void bms_handle_overtemp(bms_t *c);

bool bms_check_pack_overvolt(const bms_t *c);
void bms_handle_pack_overvolt(bms_t *c);

bool bms_check_pack_undervolt(const bms_t *c);
void bms_handle_pack_undervolt(bms_t *c);

bool bms_check_vcu_heartbeat_lost(const bms_t *c);
void bms_handle_vcu_heartbeat_lost(bms_t *c);

bool bms_check_charge_lost(const bms_t *c);
void bms_handle_charge_lost(bms_t *c, bool lost);

/* Runs the five rules in priority order. */
void bms_safety_run(bms_t *c);

/* ---------------------------------------------------------------------------
 * can_io.c
 * ------------------------------------------------------------------------ */
int  bms_can_init(void);              /* device, both filters, can_start   */
void bms_can_service_rx(bms_t *c);    /* drain received frames into state  */
void bms_can_service_tx(bms_t *c);    /* the five cadence timers + events  */
uint32_t bms_can_tx_refused(void);    /* controller would not take it      */
uint32_t bms_can_tx_failed(void);     /* accepted, then failed on the wire */

#endif /* BMS_H_ */
```

## src/can_io.c
```c
/*
 * can_io.c — everything that touches the bus.
 *
 * Two responsibilities, kept apart from the safety logic on purpose:
 *
 *   RECEIVE   two exact-match filters (vcu_command 0x200, charger_status
 *             0x300) into one message queue, drained by the control loop.
 *
 *   TRANSMIT  five independent cadence timers, plus the event path that
 *             fires the fault frame at the instant a fault is entered.
 *
 * PACKING IS THE CONTRACT. Every start_bit, length and dlc below is quoted
 * from catalog.yml on the line that uses it, so this file can be read side by
 * side with the YAML. The harness decodes with that same contract, so any
 * disagreement here shows up as a wrong value on the bus rather than as a
 * crash — which is exactly why it is written to be diffable rather than
 * clever.
 */

#include <errno.h>
#include <string.h>

#include <zephyr/kernel.h>
#include <zephyr/device.h>
#include <zephyr/drivers/can.h>
#include <zephyr/sys/printk.h>

#include "bms.h"

/* The board's CAN controller. Resolved from the devicetree `zephyr,canbus`
 * chosen node, which nucleo_h743zi points at fdcan1 — no peripheral name is
 * spelled out in this firmware. */
static const struct device *const can_dev = DEVICE_DT_GET(DT_CHOSEN(zephyr_canbus));

/* Received frames land here from the driver's interrupt context and are
 * drained by the control loop. A queue rather than shared variables because
 * the producer is an ISR: k_msgq is the ISR-safe handoff Zephyr provides, and
 * it means no receive value can be torn or lost between the two contexts.
 * 16 frames is four ticks' worth of the fastest sender on this bus. */
CAN_MSGQ_DEFINE(bms_rx_msgq, 16);

/* Two different failures, counted separately because they mean opposite
 * things and conflating them hides both:
 *
 *   tx_refused  can_send() would not take the frame -- no free TX mailbox
 *               within the timeout. The frame never reached the wire and the
 *               fault is ours: we are offering frames faster than the
 *               controller drains them.
 *
 *   tx_failed   the frame was accepted and then failed in transmission --
 *               no acknowledgement, arbitration lost repeatedly, bus error.
 *               The fault is the bus's: nobody is listening, or two nodes are
 *               fighting over the same identifier.
 *
 * Both are reported on the console rather than swallowed. A silently dropped
 * frame on a verification target is a false PASS waiting to happen. */
static volatile uint32_t tx_refused;
static volatile uint32_t tx_failed;

/* The five cadence timers. They live here, not in bms_t, because they belong
 * to the wire and not to the battery. Separate accumulators rather than one
 * shared modulo so that "independent" is a property of the code and not of a
 * comment. */
static uint32_t tx_acc_status_ms;
static uint32_t tx_acc_limits_ms;
static uint32_t tx_acc_temps_ms;
static uint32_t tx_acc_cells_ms;
static uint32_t tx_acc_fault_ms;

/* ===========================================================================
 * Field packing
 * ===========================================================================
 * catalog.yml's convention: start_bit is the LSB position of the signal in a
 * little-endian payload, bit 0 being the LSB of byte 0. Every signal the BMS
 * transmits is byte aligned (start_bit % 8 == 0), so each one is a plain
 * little-endian store at start_bit / 8.
 */

static void put_u8(uint8_t *d, unsigned start_bit, uint8_t v)
{
	d[start_bit / 8U] = v;
}

static void put_u16(uint8_t *d, unsigned start_bit, uint16_t v)
{
	unsigned i = start_bit / 8U;

	d[i]     = (uint8_t)(v & 0xFFU);
	d[i + 1U] = (uint8_t)((v >> 8) & 0xFFU);
}

static void put_u24(uint8_t *d, unsigned start_bit, uint32_t v)
{
	unsigned i = start_bit / 8U;

	d[i]      = (uint8_t)(v & 0xFFU);
	d[i + 1U] = (uint8_t)((v >> 8) & 0xFFU);
	d[i + 2U] = (uint8_t)((v >> 16) & 0xFFU);
}

/*
 * Width clamps.
 *
 * The safety rules compare the RAW injected values, so a boundary sweep gets
 * exact arithmetic with no saturation anywhere near it. Only the wire format
 * clamps — and it must. A 24-bit field handed 2 000 000 000 would wrap and
 * put a small, plausible, wrong number on the bus; a saturated value is at
 * least obviously pinned. Two's complement runs over the signal's full
 * declared width, matching catalog.yml's `signed: true` rule.
 */
static uint32_t fit_u24(int32_t v)
{
	if (v < 0) {
		return 0U;
	}
	if (v > 0xFFFFFF) {
		return 0xFFFFFFU;
	}
	return (uint32_t)v;
}

static uint32_t fit_s24(int32_t v)
{
	if (v > 8388607) {
		v = 8388607;
	} else if (v < -8388608) {
		v = -8388608;
	}
	return (uint32_t)v & 0xFFFFFFU;
}

static uint16_t fit_s16(int32_t v)
{
	if (v > 32767) {
		v = 32767;
	} else if (v < -32768) {
		v = -32768;
	}
	return (uint16_t)((uint32_t)v & 0xFFFFU);
}

/* ===========================================================================
 * Transmit
 * ===========================================================================
 */

static void tx_done(const struct device *dev, int error, void *user_data)
{
	ARG_UNUSED(dev);
	ARG_UNUSED(user_data);

	if (error != 0) {
		tx_failed++;
	}
}

static void can_tx(uint32_t id, const uint8_t *data, uint8_t dlc)
{
	struct can_frame f;
	int rc;

	memset(&f, 0, sizeof(f));
	f.id    = id;
	f.dlc   = dlc;
	f.flags = 0;             /* classic CAN, standard 11-bit id, data frame */
	memcpy(f.data, data, dlc);

	/* Callback form: can_send returns as soon as the frame is queued, and
	 * the timeout bounds only the wait for a free TX mailbox (this
	 * controller has three). The control loop must stay on its 10 ms tick,
	 * so it never waits for the wire. */
	rc = can_send(can_dev, &f, K_MSEC(2), tx_done, NULL);
	if (rc != 0) {
		tx_refused++;
	}
}

/* 0x600 bms_status — dlc 8 */
static void tx_bms_status(bms_t *c)
{
	uint8_t d[BMS_MSG_STATUS_DLC];

	memset(d, 0, sizeof(d));
	put_u24(d,  0, fit_u24(c->pack_mv));  /* pack_voltage_mv  start_bit 0,  length 24         */
	put_u24(d, 24, fit_s24(c->pack_ma));  /* pack_current_ma  start_bit 24, length 24, signed */
	put_u8 (d, 48, c->soc_pct);           /* soc_pct          start_bit 48, length 8          */
	put_u8 (d, 56, c->heartbeat);         /* bms_heartbeat    start_bit 56, length 8          */

	/* Rolling 0..255. uint8_t wraps by width, which is the declared
	 * behaviour, so no modulo is needed or wanted. */
	c->heartbeat++;

	can_tx(BMS_MSG_STATUS_ID, d, BMS_MSG_STATUS_DLC);
}

/* 0x601 bms_temps — dlc 6 */
static void tx_bms_temps(bms_t *c)
{
	uint8_t d[BMS_MSG_TEMPS_DLC];

	memset(d, 0, sizeof(d));
	put_u16(d,  0, fit_s16(c->temp_dC));      /* cell_temp_dC     start_bit 0,  length 16, signed */
	put_u16(d, 16, fit_s16(c->temp_max_dC));  /* cell_temp_max_dC start_bit 16, length 16, signed */
	put_u16(d, 32, fit_s16(c->temp_min_dC));  /* cell_temp_min_dC start_bit 32, length 16, signed */

	can_tx(BMS_MSG_TEMPS_ID, d, BMS_MSG_TEMPS_DLC);
}

/* 0x602 bms_limits — dlc 6 */
static void tx_bms_limits(bms_t *c)
{
	uint8_t d[BMS_MSG_LIMITS_DLC];

	memset(d, 0, sizeof(d));
	put_u16(d,  0, c->discharge_limit_da); /* discharge_current_limit_da start_bit 0,  length 16 */
	put_u16(d, 16, c->charge_limit_da);    /* charge_current_limit_da    start_bit 16, length 16 */
	put_u8 (d, 32, c->contactor);          /* contactor_state            start_bit 32, length 8  */

	can_tx(BMS_MSG_LIMITS_ID, d, BMS_MSG_LIMITS_DLC);
}

/* 0x603 bms_cells — dlc 6 */
static void tx_bms_cells(bms_t *c)
{
	uint8_t d[BMS_MSG_CELLS_DLC];

	memset(d, 0, sizeof(d));
	put_u16(d,  0, c->cell_max_mv);  /* cell_volt_max_mv start_bit 0,  length 16 */
	put_u16(d, 16, c->cell_min_mv);  /* cell_volt_min_mv start_bit 16, length 16 */
	put_u8 (d, 32, BMS_SOH_PCT);     /* soh_pct          start_bit 32, length 8  */

	can_tx(BMS_MSG_CELLS_ID, d, BMS_MSG_CELLS_DLC);
}

/* 0x604 bms_fault — dlc 8.
 *
 * Called from two unrelated places: the fault-entry event and the 500 ms
 * rebroadcast timer. fault_counter advances on every transmission from
 * either, which is what makes it the rolling field the harness's masked
 * matcher has to be able to ignore. */
static void tx_bms_fault(bms_t *c)
{
	uint8_t d[BMS_MSG_FAULT_DLC];

	memset(d, 0, sizeof(d));
	put_u8(d, 0, c->fault_code);     /* fault_code    start_bit 0, length 8 */
	put_u8(d, 8, c->fault_counter);  /* fault_counter start_bit 8, length 8 */

	/* catalog.yml declares dlc 8 with only 16 bits of signal: bytes 2..7 are
	 * spare on purpose, reserved for a later revision. Sent as zero. */

	c->fault_counter++;

	can_tx(BMS_MSG_FAULT_ID, d, BMS_MSG_FAULT_DLC);
}

/* One cadence timer. Subtracting the period rather than zeroing the
 * accumulator keeps the phase exact: a period that is a multiple of the tick
 * can never drift, so 100 ms means every tenth tick forever. */
static bool tx_timer_due(uint32_t *acc_ms, uint32_t period_ms)
{
	*acc_ms += BMS_TICK_MS;
	if (*acc_ms >= period_ms) {
		*acc_ms -= period_ms;
		return true;
	}
	return false;
}

void bms_can_service_tx(bms_t *c)
{
	bool status_due, limits_due, temps_due, cells_due, fault_due;

	/* All five timers advance every tick whether or not anything is
	 * transmitted, so silencing the node does not shift its phase: when it
	 * comes back it resumes on the grid it would have been on. */
	status_due = tx_timer_due(&tx_acc_status_ms, BMS_TX_PERIOD_STATUS_MS);
	limits_due = tx_timer_due(&tx_acc_limits_ms, BMS_TX_PERIOD_LIMITS_MS);
	temps_due  = tx_timer_due(&tx_acc_temps_ms,  BMS_TX_PERIOD_TEMPS_MS);
	cells_due  = tx_timer_due(&tx_acc_cells_ms,  BMS_TX_PERIOD_CELLS_MS);
	fault_due  = tx_timer_due(&tx_acc_fault_ms,  BMS_TX_PERIOD_FAULT_MS);

	/*
	 * g_tx_enable == 0 stops ALL transmission. This is how node_silence
	 * works on a real node, so it has to be total: no telemetry, no fault
	 * frame, not even the one a fault raised this very tick. The pending
	 * event is discarded rather than queued, because a silenced ECU is off
	 * the bus, not buffering — a burst on re-enable would be a fiction the
	 * harness could measure.
	 *
	 * Re-read every cycle from the volatile global, never cached.
	 */
	if (c->tx_on == 0U) {
		c->fault_event_pending = false;
		return;
	}

	/*
	 * The event path. A fault frame goes out the moment a rule fires,
	 * ahead of this tick's telemetry, because it is the frame the reaction
	 * latency is measured on.
	 */
	if (c->fault_event_pending) {
		c->fault_event_pending = false;
		tx_bms_fault(c);
	}

	if (status_due) {
		tx_bms_status(c);
	}
	if (limits_due) {
		tx_bms_limits(c);
	}
	if (temps_due) {
		tx_bms_temps(c);
	}
	if (cells_due) {
		tx_bms_cells(c);
	}

	/*
	 * The rebroadcast path, deliberately NOT merged with the event path
	 * above and deliberately NOT derived from the 500 ms cells timer.
	 *
	 * Entering a fault and periodically restating one are different events.
	 * When a fault is entered on a tick where this free-running timer is
	 * also due, 0x604 is transmitted twice in that millisecond, with
	 * consecutive fault_counter values. That is correct, and collapsing it
	 * into one frame would hide the distinction the log is there to show.
	 *
	 * Only an ACTIVE fault is rebroadcast: there is no such thing as
	 * periodically announcing the absence of a fault, and a stream of
	 * fault_code NONE frames would make expect_no_can(0x604) meaningless.
	 */
	if (fault_due && c->fault_code != BMS_FAULT_NONE) {
		tx_bms_fault(c);
	}
}

/* ===========================================================================
 * Receive
 * ===========================================================================
 */

void bms_can_service_rx(bms_t *c)
{
	struct can_frame f;

	while (k_msgq_get(&bms_rx_msgq, &f, K_NO_WAIT) == 0) {
		switch (f.id) {
		case BMS_MSG_VCU_COMMAND_ID:
			/* vcu_command, dlc 8. vcu_heartbeat sits at start_bit
			 * 32, so five bytes is the minimum useful frame. */
			if (f.dlc < 5U) {
				break;
			}
			c->rx_vcu_count++;
			c->vcu_seen      = true;
			c->vcu_heartbeat = f.data[4];  /* vcu_heartbeat start_bit 32, length 8 */

			/*
			 * The heartbeat deadline is refreshed on ARRIVAL of
			 * vcu_command, not on a change of vcu_heartbeat. Rule 4
			 * is about the message stopping — which is what a
			 * silenced node does — and a frame player repainting a
			 * constant payload is still a node that is present on
			 * the bus. Refreshing on counter change instead would
			 * turn "the VCU is scripted" into a heartbeat fault.
			 */
			c->vcu_age_ms = 0U;

			{
				uint8_t ds = f.data[0]; /* drive_state start_bit 0, length 8 */

				/* Every state in which the wheels can turn
				 * needs HV up. PARKED and SHUTDOWN do not. */
				c->drive_request = (ds == BMS_DRIVE_READY) ||
						   (ds == BMS_DRIVE_DRIVE) ||
						   (ds == BMS_DRIVE_REVERSE) ||
						   (ds == BMS_DRIVE_LIMP);
			}
			break;

		case BMS_MSG_CHARGER_STATUS_ID:
			/* charger_status, dlc 8. charge_state is byte 0. */
			if (f.dlc < 1U) {
				break;
			}
			c->rx_chg_count++;
			c->charge_state = f.data[0];  /* charge_state start_bit 0, length 8 */

			{
				/* Only these three mean the charger is actually
				 * negotiating or delivering power. Rule 5 times
				 * the loss of POWER, not the loss of frames, so
				 * a charger sitting there reporting IDLE does
				 * not hold the session open. */
				bool active = (c->charge_state == BMS_CHARGE_HANDSHAKE) ||
					      (c->charge_state == BMS_CHARGE_CONSTANT_CURRENT) ||
					      (c->charge_state == BMS_CHARGE_CONSTANT_VOLTAGE);

				c->charge_request = active;
				if (active) {
					/* This is also the re-handshake that
					 * clears a non-latching CHARGE_LOST. */
					c->charge_age_ms = 0U;
				}
			}
			break;

		default:
			/* Unreachable: both filters are exact-match, so no other
			 * id is ever delivered to the CPU. An unexpected frame
			 * on this bus costs the BMS nothing and cannot fault
			 * it. */
			break;
		}
	}
}

uint32_t bms_can_tx_refused(void)
{
	return tx_refused;
}

uint32_t bms_can_tx_failed(void)
{
	return tx_failed;
}

/* ===========================================================================
 * Bring-up
 * ===========================================================================
 */

int bms_can_init(void)
{
	/* Exact-match filters. mask = CAN_STD_ID_MASK means every id bit must
	 * match, so only these two ids reach the CPU.
	 *
	 * .flags = CAN_FILTER_DATA is REQUIRED. With flags = 0 the filter
	 * matches nothing and can_add_rx_filter() returns -EINVAL, which reads
	 * like a broken platform and is not. */
	const struct can_filter vcu_filter = {
		.id    = BMS_MSG_VCU_COMMAND_ID,
		.mask  = CAN_STD_ID_MASK,
		.flags = CAN_FILTER_DATA,
	};
	const struct can_filter chg_filter = {
		.id    = BMS_MSG_CHARGER_STATUS_ID,
		.mask  = CAN_STD_ID_MASK,
		.flags = CAN_FILTER_DATA,
	};
	int rc;

	if (!device_is_ready(can_dev)) {
		printk("bms can NOT READY init_res=%d\n", (int)can_dev->state->init_res);
		return -ENODEV;
	}
	printk("bms can ready init_res=%d\n", (int)can_dev->state->init_res);

	rc = can_add_rx_filter_msgq(can_dev, &bms_rx_msgq, &vcu_filter);
	printk("bms filter vcu_command rc=%d\n", rc);
	if (rc < 0) {
		return rc;
	}

	rc = can_add_rx_filter_msgq(can_dev, &bms_rx_msgq, &chg_filter);
	printk("bms filter charger_status rc=%d\n", rc);
	if (rc < 0) {
		return rc;
	}

	rc = can_start(can_dev);
	printk("bms can_start rc=%d\n", rc);
	return rc;
}
```
