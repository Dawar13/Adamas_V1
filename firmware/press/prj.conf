## CMakeLists.txt
```
cmake_minimum_required(VERSION 3.20.0)

find_package(Zephyr REQUIRED HINTS $ENV{ZEPHYR_BASE})
project(press)

target_sources(app PRIVATE
	src/main.c
	src/safety.c
	src/can_io.c
)

# Keep every injectable symbol in the ELF. Zephyr compiles with -fdata-sections
# and links with --gc-sections, so a global that nothing reads is discarded at
# link time -- `volatile` does not prevent it, because collection happens in the
# linker where volatile has no say. A discarded symbol gives write_symbol no
# address to write: the fault is never injected and the scenario still reports
# PASS, which is the worst failure a verification tool can have.
#
# One list, two independent uses, neither trusted on its own.
include(${CMAKE_CURRENT_SOURCE_DIR}/../injectables.cmake)
bench_retain_injectables()
```

## prj.conf
```kconfig
# The pressure-sensor node — the second example system's device under test.
#
# Console over UART. This board's overlay chooses usart2, not the board
# definition's default usart3, and examples/sensor-node/boards.yml names
# sysbus.usart2 as the instance the harness taps. Those two must agree or the
# banner is never seen and every scenario fails on wait_uart.
CONFIG_PRINTK=y
CONFIG_CONSOLE=y
CONFIG_SERIAL=y
CONFIG_UART_CONSOLE=y

# CAN. The controller comes from the devicetree `zephyr,canbus` chosen node,
# which the overlay points at fdcan2; no peripheral name appears in the C.
CONFIG_CAN=y

# Driver errors on the console rather than in silence. A controller that fails
# to configure its bit timing still boots and still prints the banner -- it just
# never speaks, which is indistinguishable from broken application logic unless
# the driver is allowed to say so.
CONFIG_LOG=y
CONFIG_LOG_MODE_IMMEDIATE=y
CONFIG_CAN_LOG_LEVEL_ERR=y

# The same binary shape we intend to run under test, not a special emulator
# build. The claim is that the binary under test is the binary that ships.
CONFIG_ASSERT=y
```

## boards/nucleo_h743zi.overlay
```dts
/*
 * The pressure node's board wiring: fdcan2 and usart2.
 *
 * ---------------------------------------------------------------------------
 * WHY A DIFFERENT CAN INSTANCE AND A DIFFERENT CONSOLE
 * ---------------------------------------------------------------------------
 * This is the second example system's whole job (Phase 3 §13). All three of the
 * first system's boards use fdcan1 and usart3, so nothing until now has ever
 * proved the harness READS those names out of the board table rather than
 * assuming them. This overlay is what makes the proof possible: if any part of
 * the engine had fdcan1 or usart3 baked in, this firmware boots and the harness
 * taps nothing.
 *
 * Nothing in the C changes. The controller comes from `zephyr,canbus` and the
 * console from `zephyr,console`, both resolved at build time from here.
 *
 * ---------------------------------------------------------------------------
 * BITRATE
 * ---------------------------------------------------------------------------
 * network.yml declares the process bus at 250 kbit/s -- also different from the
 * scooter's 500. scripts/build-firmware.sh reads the value back out of the
 * GENERATED devicetree and fails the build if it disagrees with the topology,
 * because what matters is what the compiler concluded, not what we believe we
 * asked for. Nodes on mismatched bitrates produce a bus carrying no traffic at
 * all, and neither the firmware nor the emulator reports an error.
 *
 * ---------------------------------------------------------------------------
 * MESSAGE RAM
 * ---------------------------------------------------------------------------
 * Same shape as the first system's, and for the same reason: Zephyr's stock
 * <0x0 28 0 3 3 0 3 3> allocates more elements than the H743's 2560-word window
 * holds once the 72-byte TX elements are counted, and the build stops on a
 * BUILD_ASSERT. Offsets start at 0 because this node uses only fdcan2 -- fdcan1
 * and fdcan2 share one message-RAM region on this part, and each node runs in
 * its own emulated machine, so nothing else is allocating out of it.
 */

&fdcan2 {
	pinctrl-0 = <&fdcan2_tx_pb13 &fdcan2_rx_pb12>;
	pinctrl-names = "default";
	bus-speed = <250000>;
	/* Required by st,stm32h7-fdcan whether or not the data phase is used.
	 * The board dts supplies it for fdcan1; fdcan2 is left disabled and
	 * unconfigured, so enabling it means supplying every mandatory property.
	 * Classic CAN only here -- no frame on this bus is FD -- but the binding
	 * demands a data-phase rate regardless, so it is stated rather than
	 * omitted and left for the generator to reject. */
	bus-speed-data = <1000000>;
	bosch,mram-cfg = <0x0 8 0 3 1 0 5 6>;
	status = "okay";
};

/* The console moves to usart2. usart3 stays as the board defines it and is
 * simply not chosen -- the harness taps whatever the board table names. */
&usart2 {
	pinctrl-0 = <&usart2_tx_pd5 &usart2_rx_pd6>;
	pinctrl-names = "default";
	current-speed = <115200>;
	status = "okay";
};

/ {
	chosen {
		zephyr,canbus = &fdcan2;
		zephyr,console = &usart2;
		zephyr,shell-uart = &usart2;
	};
};
```

## src/main.c
```c
/*
 * Industrial pressure-sensor node — main loop.
 *
 * One 10 ms tick, in a fixed order, every time:
 *
 *   1  advance time and the controller's age counter
 *   2  sample the injectable inputs once, into this tick's snapshot
 *   3  drain received frames
 *   4  run the safety rules
 *   5  run the state machine
 *   6  transmit whatever this tick's cadence makes due
 *
 * Nothing in that order depends on a clock, a random source, or a float.
 */

#include <string.h>

#include <zephyr/kernel.h>
#include <zephyr/sys/printk.h>

#include "press.h"

/* ===========================================================================
 * The injectable inputs
 * ===========================================================================
 * volatile stops the compiler folding away a global this translation unit only
 * reads. It does NOT stop the linker collecting it: Zephyr compiles with
 * -fdata-sections and links with --gc-sections, and collection happens in the
 * linker, where volatile has no say. injectables.txt plus injectables.cmake
 * emit -Wl,--undefined for each name, and the build gate then asserts each one
 * really landed in the ELF.
 *
 * That belt-and-braces exists because of an observed failure on the first
 * system: a discarded symbol gives write_symbol no address to write, so the
 * fault is never injected, the firmware behaves correctly for the input it
 * actually has, and the scenario reports PASS. A test that cannot fail is worse
 * than no test.
 *
 * Every one of these is genuinely read, every tick, and drives real logic.
 */

/* The process pressure the transducer chain reports, in kPa. Compared against
 * OVERPRESSURE_LIMIT_KPA by R1 and published in press_measure. */
volatile uint16_t g_pressure_kpa = 1000;

/* The medium temperature, in tenths of a degree, signed because process fluid
 * can sit below zero. Published; no rule keys off it, which is deliberate --
 * it is the field that proves a published signal and an asserted signal are
 * different things. */
volatile int16_t g_medium_temp_dC = 200;

/* Whether this node transmits at all. A scenario silences a node through this
 * without knowing whether the node runs real firmware or is a frame player;
 * that symmetry is what keeps scenarios portable between the two. */
volatile uint8_t g_tx_enable = 1;

static struct press press;

int main(void)
{
	int rc;

	memset(&press, 0, sizeof(press));
	press.state = SENSOR_INIT;
	press.alarm = ALARM_CLEAR;
	press.latched = false;

	rc = press_can_init();

	/*
	 * The banner is what wait_uart matches, and it is printed AFTER CAN
	 * initialisation with the result attached. A node that announces itself
	 * ready and then cannot speak is the failure mode that cost a board
	 * bring-up on the first system: it looks exactly like broken application
	 * logic, and nothing anywhere reports an error.
	 */
	printk("PRESS ready\n");
	printk("press can_init rc=%d bus=%u kbit\n", rc, 250u);

	while (1) {
		/* 1 — time. A count of executed ticks, never a clock read. */
		press.ticks++;
		press.now_ms = press.ticks * PRESS_TICK_MS;
		if (press.plc_seen) {
			press.since_plc_ms += PRESS_TICK_MS;
		}

		/*
		 * 2 — sample the injectables ONCE.
		 *
		 * Every rule and every frame in this tick sees the same reading.
		 * Re-reading a volatile mid-tick would let an injection land
		 * between two reads and produce a tick that acted on two
		 * different pressures, which is a race a test could not
		 * reproduce and the harness could not attribute.
		 */
		press.pressure_kpa = g_pressure_kpa;
		press.medium_temp_dC = g_medium_temp_dC;
		press.tx_enabled = (g_tx_enable != 0);

		/* 3 — received frames. */
		press_can_drain(&press);

		/* 4 — the safety rules. */
		press_safety(&press);

		/* 5 — the state machine. */
		switch (press.state) {
		case SENSOR_INIT:
			press.state = SENSOR_SETTLING;
			printk("press state INIT -> SETTLING @%u ms\n", press.now_ms);
			break;
		case SENSOR_SETTLING:
			if (press.now_ms >= SETTLING_MS) {
				press.state = SENSOR_MEASURING;
				printk("press state SETTLING -> MEASURING @%u ms\n",
				       press.now_ms);
			}
			break;
		case SENSOR_MEASURING:
			if (press.latched) {
				press.state = SENSOR_FAULTED;
				printk("press state MEASURING -> FAULTED @%u ms alarm=%u\n",
				       press.now_ms, (unsigned)press.alarm);
			}
			break;
		case SENSOR_FAULTED:
			/*
			 * Terminal. R2: an alarm latches, so there is no path
			 * back to MEASURING. A recoverable alarm would be a
			 * different rule and would need its own scenario; the
			 * scooter's charge-loss rule is the non-latching case
			 * and this one is deliberately not.
			 */
			break;
		}

		/* 6 — transmit. */
		press_can_transmit(&press);

		k_msleep(PRESS_TICK_MS);
	}

	return 0;
}
```

## src/can_io.c
```c
/*
 * can_io.c — everything the pressure node puts on, or takes off, the bus.
 *
 * RECEIVE   one exact-match filter, plc_command 0x0B0, into a message queue
 *           drained by the control loop.
 *
 * TRANSMIT  two independent cadences: the measurement always, and the alarm
 *           while one stands, plus the event path that fires the alarm frame at
 *           the instant it is raised.
 *
 * PACKING IS THE CONTRACT. Every start_bit, length and dlc below is quoted from
 * examples/sensor-node/catalog.yml on the line that uses it, so the two can be
 * read side by side. The harness decodes with that same contract, so any
 * disagreement here appears as a wrong value on the bus rather than a crash --
 * which is why this is written to be diffable rather than clever.
 *
 * NO PERIPHERAL NAME APPEARS IN THIS FILE. The controller comes from the
 * devicetree `zephyr,canbus` chosen node, which this board's overlay points at
 * fdcan2. That is the whole reason the second example system can use a different
 * CAN instance without one line of C changing.
 */

#include <errno.h>
#include <string.h>

#include <zephyr/kernel.h>
#include <zephyr/device.h>
#include <zephyr/drivers/can.h>
#include <zephyr/sys/printk.h>

#include "press.h"

static const struct device *const can_dev = DEVICE_DT_GET(DT_CHOSEN(zephyr_canbus));

/* Received frames arrive from the driver's interrupt context and are drained by
 * the control loop. A queue rather than shared variables because the producer
 * is an ISR, so no received value can be torn between the two contexts.
 * 8 frames is eight ticks' worth of the only sender this node listens to. */
CAN_MSGQ_DEFINE(press_rx_msgq, 8);

/* Two failures that mean opposite things, counted apart so neither hides the
 * other: refused means no free mailbox and the fault is ours; failed means the
 * frame was accepted and died on the wire, and the fault is the bus's. Both are
 * printed, because a silently dropped frame on a verification target is a false
 * PASS waiting to happen. */
static volatile uint32_t tx_refused;
static volatile uint32_t tx_failed;

static uint32_t tx_acc_measure_ticks;
static uint32_t tx_acc_alarm_ticks;

/* ===========================================================================
 * Field packing
 * ===========================================================================
 * catalog.yml's convention: start_bit is the LSB position of the signal in a
 * little-endian payload, bit 0 being the LSB of byte 0. Every signal this node
 * transmits is byte aligned, so each is a plain store.
 */
static inline void put_u8(uint8_t *data, int start_bit, uint8_t v)
{
	data[start_bit / 8] = v;
}

static inline void put_u16(uint8_t *data, int start_bit, uint16_t v)
{
	data[start_bit / 8] = (uint8_t)(v & 0xFF);
	data[start_bit / 8 + 1] = (uint8_t)((v >> 8) & 0xFF);
}

static inline uint8_t get_u8(const uint8_t *data, int start_bit)
{
	return data[start_bit / 8];
}

static void tx_done(const struct device *dev, int error, void *arg)
{
	ARG_UNUSED(dev);
	ARG_UNUSED(arg);
	if (error != 0) {
		tx_failed++;
	}
}

static void send(struct press *p, uint16_t id, uint8_t dlc, const uint8_t *data)
{
	struct can_frame f;
	int rc;

	/*
	 * g_tx_enable is checked HERE, at the one point every frame passes
	 * through, rather than at each call site. A scenario silences this node
	 * by writing that symbol, and a silence that applied to some frames and
	 * not others would be a silence the test could not reason about.
	 */
	if (!p->tx_enabled) {
		return;
	}

	memset(&f, 0, sizeof(f));
	f.id = id;
	f.dlc = dlc;
	memcpy(f.data, data, dlc);

	/* Callback form: returns as soon as the frame is queued, so the control
	 * loop never waits on the wire and bus conditions cannot change how many
	 * ticks elapse. That is a determinism requirement, not an optimisation. */
	rc = can_send(can_dev, &f, K_MSEC(2), tx_done, NULL);
	if (rc != 0) {
		tx_refused++;
		printk("press tx refused id=0x%03X rc=%d\n", id, rc);
	}
}

/* ===========================================================================
 * Receive
 * =========================================================================== */
void press_can_drain(struct press *p)
{
	struct can_frame f;

	while (k_msgq_get(&press_rx_msgq, &f, K_NO_WAIT) == 0) {
		if (f.id != ID_PLC_COMMAND) {
			continue;
		}
		/*
		 * The controller spoke. Reset its age and record that it has
		 * been seen at least once -- R3 only starts counting after
		 * that, so a node that boots before its controller does not
		 * fault about an absence that has not yet become a failure.
		 */
		p->since_plc_ms = 0;
		if (!p->plc_seen) {
			p->plc_seen = true;
			printk("press plc first seen @%u ms hb=%u\n", p->now_ms,
			       (unsigned)get_u8(f.data, 0)); /* plc_heartbeat, start_bit 0 */
		}
	}
}

/* ===========================================================================
 * Transmit
 * =========================================================================== */
static void send_measure(struct press *p)
{
	uint8_t d[6] = { 0 };

	/* press_measure 0x0A0, dlc 6 */
	put_u16(d, 0, p->pressure_kpa);              /* pressure_kpa,    16 */
	put_u16(d, 16, (uint16_t)p->medium_temp_dC); /* medium_temp_dC,  16, signed */
	put_u8(d, 32, (uint8_t)p->state);            /* sensor_state,     8 */
	put_u8(d, 40, p->measure_counter);           /* measure_counter,  8 */

	p->measure_counter++; /* rolling, wraps at 255 -- the contract says so */
	send(p, ID_PRESS_MEASURE, 6, d);
}

static void send_alarm(struct press *p)
{
	uint8_t d[4] = { 0 };

	/* press_alarm 0x0A2, dlc 4 */
	put_u8(d, 0, (uint8_t)p->alarm);          /* alarm_code, 8 */
	put_u8(d, 8, p->latched ? 1 : 0);         /* latched,    8 */
	put_u8(d, 16, p->alarm_seq);              /* alarm_seq,  8 */

	p->alarm_seq++;
	send(p, ID_PRESS_ALARM, 4, d);
}

void press_can_transmit(struct press *p)
{
	bool alarm_stands = (p->alarm != ALARM_CLEAR);

	tx_acc_measure_ticks++;
	if (tx_acc_measure_ticks >= MEASURE_PERIOD_TICKS) {
		tx_acc_measure_ticks = 0;
		send_measure(p);
	}

	if (!alarm_stands) {
		/* Reset the cadence so that the FIRST alarm frame goes out on
		 * the tick the alarm is raised, not up to 100 ms later. The
		 * scenarios assert a deadline from the injection, and a phase
		 * offset here would be measured as firmware latency. */
		tx_acc_alarm_ticks = ALARM_PERIOD_TICKS;
		return;
	}

	tx_acc_alarm_ticks++;
	if (tx_acc_alarm_ticks >= ALARM_PERIOD_TICKS) {
		tx_acc_alarm_ticks = 0;
		send_alarm(p);
	}
}

/* ===========================================================================
 * Init
 * =========================================================================== */
int press_can_init(void)
{
	/*
	 * .flags = CAN_FILTER_DATA is REQUIRED. With flags = 0 the filter
	 * matches nothing and can_add_rx_filter() returns -EINVAL. That cost
	 * real time on the first system: the node boots, announces itself, and
	 * receives nothing, which is indistinguishable from a peer that never
	 * transmitted.
	 */
	const struct can_filter plc_filter = {
		.id = ID_PLC_COMMAND,
		.mask = CAN_STD_ID_MASK,
		.flags = CAN_FILTER_DATA,
	};
	int rc;

	if (!device_is_ready(can_dev)) {
		printk("press can NOT READY init_res=%d\n", (int)can_dev->state->init_res);
		return -ENODEV;
	}
	printk("press can ready init_res=%d\n", (int)can_dev->state->init_res);

	rc = can_add_rx_filter_msgq(can_dev, &press_rx_msgq, &plc_filter);
	printk("press filter plc_command rc=%d\n", rc);
	if (rc < 0) {
		return rc;
	}

	rc = can_start(can_dev);
	printk("press can_start rc=%d\n", rc);
	return rc;
}
```

## src/press.h
```c
/*
 * Industrial pressure-sensor node — the device under test of the SECOND
 * example system.
 *
 * Its job is to be a completely different piece of firmware from the scooter's
 * BMS: a different domain, different identifiers, a different bus speed, a
 * different CAN instance and a different console UART. It shares no header, no
 * enum spelling and no message with it.
 *
 * The safety behaviour it implements, and which the scenarios assert:
 *
 *   R1  over-pressure          pressure ABOVE the limit raises OVERPRESSURE.
 *                              The limit itself is legal -- strict comparison,
 *                              which is the semantics the sweep pattern calls
 *                              `strict` and where a > / >= slip hides.
 *   R2  latching               once raised, an alarm never clears, whatever the
 *                              reading does afterwards.
 *   R3  controller liveness    the controller's periodic word must keep
 *                              arriving. Silence past the timeout raises
 *                              CONTROLLER_LOST.
 *
 * DETERMINISM. No rand, no wall clock in any decision, no floating point, no
 * unbounded blocking, and every timeout counted in ticks rather than measured.
 * The one clock is the pacing timer, re-armed by the kernel from its previous
 * expiry so it cannot drift; under the emulator that clock is virtual time.
 */

#ifndef PRESS_H_
#define PRESS_H_

#include <stdint.h>
#include <stdbool.h>

/* --------------------------------------------------------------------------
 * Cadence
 * -------------------------------------------------------------------------- */
#define PRESS_TICK_MS 10

/* Published cadences, in ticks of PRESS_TICK_MS. */
#define MEASURE_PERIOD_TICKS 10 /* 0x0A0 every 100 ms */
#define ALARM_PERIOD_TICKS 10   /* 0x0A2 every 100 ms while an alarm stands */

/* --------------------------------------------------------------------------
 * The safety limits
 * --------------------------------------------------------------------------
 * One place each. A scenario asserts against these numbers and a sweep steps
 * across them, so a limit that appeared twice could drift between its copies
 * and the tests would still pass against whichever one they happened to read.
 */

/* R1: strictly ABOVE this is a fault. 4000 kPa itself is legal. */
#define OVERPRESSURE_LIMIT_KPA 4000

/* R3: the controller's word must arrive at least this often. */
#define CONTROLLER_TIMEOUT_MS 500

/* Settling: the reading is not trusted for this long after boot.
 *
 * LONG ENOUGH TO BE OBSERVABLE, AND TO STILL BE TRUE WHEN A TEST INJECTS.
 *
 * This started at 50 ms, which ended before the first measurement frame went
 * out at 100 ms -- so no observer could ever see the node report SETTLING, and
 * the sweep generator rightly refused a timing dimension whose two instants
 * both landed in MEASURING: two moments meeting the device in the same
 * condition are one test run twice.
 *
 * 250 ms fixed the observability and not the injection. A pattern's timed
 * instant is measured from AFTER the boot wait, and wait_uart spends its whole
 * timeout of virtual time however early the banner appears -- so with a 100 ms
 * boot wait, an instant "200 ms in" lands at 300 ms absolute. A state that ends
 * at 250 ms is witnessed correctly beforehand and is already over by the time
 * the stimulus arrives, which would make the test's own description false.
 *
 * 400 ms outlasts both, and is what a real transducer chain takes to stabilise.
 */
#define SETTLING_MS 400

/* --------------------------------------------------------------------------
 * The contract, as this firmware sees it
 * --------------------------------------------------------------------------
 * These mirror examples/sensor-node/catalog.yml. The firmware and the contract
 * are two independent statements of the same thing on purpose: the tests read
 * the contract, the firmware reads this, and a disagreement between them is a
 * test failure rather than something both sides quietly share.
 */
#define ID_PRESS_MEASURE 0x0A0
#define ID_PRESS_ALARM 0x0A2
#define ID_PLC_COMMAND 0x0B0

enum sensor_state {
	SENSOR_INIT = 0,
	SENSOR_SETTLING = 1,
	SENSOR_MEASURING = 2,
	SENSOR_FAULTED = 3,
};

enum alarm_code {
	ALARM_CLEAR = 0,
	ALARM_OVERPRESSURE = 1,
	ALARM_CONTROLLER_LOST = 2,
	ALARM_TRANSDUCER_OPEN = 3,
};

/* --------------------------------------------------------------------------
 * State
 * -------------------------------------------------------------------------- */
struct press {
	uint32_t now_ms;   /* ticks * PRESS_TICK_MS, never a clock read */
	uint32_t ticks;

	/* This tick's snapshot of the injectable inputs, sampled once so every
	 * rule and every frame sees the same reading. */
	uint16_t pressure_kpa;
	int16_t medium_temp_dC;
	bool tx_enabled;

	enum sensor_state state;

	/* The alarm, and the fact that it latches. */
	enum alarm_code alarm;
	bool latched;
	uint8_t alarm_seq;

	/* Controller liveness. Counted in ms of elapsed ticks, not measured. */
	uint32_t since_plc_ms;
	bool plc_seen;

	uint8_t measure_counter;
	uint32_t measure_due_ticks;
	uint32_t alarm_due_ticks;
};

/* --------------------------------------------------------------------------
 * The injectable inputs
 * --------------------------------------------------------------------------
 * Written by the harness through the ELF symbol table, into the running
 * machine's memory, exactly as a transducer's driver would. The firmware
 * cannot tell the two apart -- which is the whole mechanism, and the reason
 * the transducer and its ADC transaction are NOT exercised by any of this.
 */
extern volatile uint16_t g_pressure_kpa;
extern volatile int16_t g_medium_temp_dC;
extern volatile uint8_t g_tx_enable;

/* safety.c */
void press_safety(struct press *p);

/* can_io.c */
int press_can_init(void);
void press_can_drain(struct press *p);
void press_can_transmit(struct press *p);

#endif /* PRESS_H_ */
```

## src/safety.c
```c
/*
 * The safety rules for the pressure-sensor node.
 *
 * Three rules, in a fixed order. Each one is a single comparison against a
 * single limit defined once in press.h, because a limit that appears twice can
 * drift between its copies while every test still passes against whichever
 * copy it happened to read.
 */

#include <zephyr/sys/printk.h>

#include "press.h"

/*
 * Raise an alarm, once.
 *
 * R2 -- LATCHING. The first alarm to fire is the one that stands. A later,
 * different alarm does not overwrite it: the reader needs to know what went
 * wrong FIRST, and a code that changes while the condition persists makes the
 * bus record ambiguous about which fault the operator is looking at.
 */
static void raise_alarm(struct press *p, enum alarm_code code)
{
	if (p->latched) {
		return;
	}
	p->alarm = code;
	p->latched = true;
	printk("press ALARM %u @%u ms pressure=%u kPa\n", (unsigned)code,
	       p->now_ms, (unsigned)p->pressure_kpa);
}

void press_safety(struct press *p)
{
	/*
	 * R1 -- OVER-PRESSURE.
	 *
	 * STRICTLY GREATER THAN. The limit itself is legal, so 4000 kPa passes
	 * and 4001 kPa faults. That is a decision about the contract, not a
	 * detail: the sweep pattern calls this comparison `strict` and steps a
	 * test onto the limit and one unit past it precisely because > and >=
	 * agree everywhere except here.
	 *
	 * The first system's defective build differs from its good one by
	 * exactly this character, and every one of its original scenarios
	 * passed against it. The boundary pair is what catches it.
	 */
	/*
	 * Checked in EVERY state, including SETTLING.
	 *
	 * A deliberate fail-safe choice, not an oversight: an over-pressure is
	 * dangerous whether or not the transducer chain has finished
	 * stabilising, and a node that stayed silent for its first 250 ms would
	 * have a window in which the process could exceed its limit unreported.
	 * The sweep injects during both states precisely to hold this decision
	 * in place -- if someone later gates the rule on SETTLING, one half of
	 * that sweep goes red.
	 */
	if (p->pressure_kpa > OVERPRESSURE_LIMIT_KPA) {
		raise_alarm(p, ALARM_OVERPRESSURE);
	}

	/*
	 * R3 -- CONTROLLER LIVENESS.
	 *
	 * The age counter only advances once the controller has been seen at
	 * least once (see main.c). Without that, a node that boots before its
	 * controller would fault on startup for a controller that had simply
	 * not spoken yet -- a fault raised about an absence that had not yet
	 * become a failure.
	 */
	if (p->plc_seen && p->since_plc_ms >= CONTROLLER_TIMEOUT_MS) {
		raise_alarm(p, ALARM_CONTROLLER_LOST);
	}
}
```
